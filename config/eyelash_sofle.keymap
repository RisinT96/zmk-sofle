// Heavily inspired by https://github.com/urob/zmk-config

#include <behaviors.dtsi>
#include <dt-bindings/zmk/bt.h>
#include <dt-bindings/zmk/ext_power.h>
#include <dt-bindings/zmk/keys.h>
#include <dt-bindings/zmk/outputs.h>
#include <dt-bindings/zmk/rgb.h>
#include <input/processors.dtsi>

#include "key-labels.h"
#include "zmk-helpers/helper.h"

#define LAYER_BASE  0
#define LAYER_NAV   1
#define LAYER_FN    2
#define LAYER_SYS   3

#define XXX &none
#define ___ &trans

/* ======================================= Global Defaults ====================================== */

#define QUICK_TAP_MS 200

&sk {
  release-after-ms = <900>;
  quick-release;
};

&sl { // Allow sticky mods to chord across sticky layers.
  ignore-modifiers;
};

&lt {
  flavor = "balanced";
  tapping-term-ms = <200>;
  quick-tap-ms = <QUICK_TAP_MS>;
};

/* ======================================== Home Row Mods ======================================= */

// Left-hand keys.
#define KEYS_L LN0 LN1 LN2 LN3 LN4 LN5 \
               LT0 LT1 LT2 LT3 LT4 LT5 \
               LM0 LM1 LM2 LM3 LM4 LM5 \
               LB0 LB1 LB2 LB3 LB4 LB5

// Right-hand keys.
#define KEYS_R RN0 RN1 RN2 RN3 RN4 RN5 \
               RT0 RT1 RT2 RT3 RT4 RT5 \
               RM0 RM1 RM2 RM3 RM4 RM5 \
               RB0 RB1 RB2 RB3 RB4 RB5

// Thumb keys.
#define THUMBS LH4 LH3 LH2 LH1 LH0 \
               RH0 RH1 RH2 RH3 RH4

#define MAKE_HRM(NAME, HOLD, TAP, TRIGGER_POS)      \
    ZMK_HOLD_TAP(                                   \
        NAME,                                       \
        bindings = <HOLD>, <TAP>;                   \
        flavor = "balanced";                        \
        tapping-term-ms = <280>;                    \
        quick-tap-ms = <QUICK_TAP_MS>;              \
        require-prior-idle-ms = <150>;              \
        hold-trigger-on-release;                    \
        hold-trigger-key-positions = <TRIGGER_POS>; \
    )

MAKE_HRM(hml, &kp, &kp, KEYS_R THUMBS) // Left-hand HRMs.
MAKE_HRM(hmr, &kp, &kp, KEYS_L THUMBS) // Right-hand HRMs.

/* ======================== Combos, Leader Key Sequences, Mouse Emulation ======================= */

#include "combos.dtsi"
#include "leader.dtsi"
#include "mouse.dtsi"

/* ====================================== Custom Behaviors ====================================== */

// Alt+Tab, requires tri-state module.
ZMK_TRI_STATE(alt_tab, bindings = <&kt LALT>, <&kp TAB>, <&kt LALT>;
              ignored-key-positions = <LT2 RT2 RM1 RM2 RM3>;)

// Shift+Tab, requires tri-state module.
ZMK_TRI_STATE(ctrl_tab, bindings = <&kt LCTRL>, <&kp TAB>, <&kt LCTRL>;
              ignored-key-positions = <LT2 RT2 RM1 RM2 RM3>;)

// Define mod-morph with a *single* mod trigger for less repetition.
#define SIMPLE_MORPH(NAME, MOD, BINDING1, BINDING2)   \
    ZMK_MOD_MORPH(NAME,                               \
                  mods = <(MOD_L##MOD | MOD_R##MOD)>; \
                  bindings = <BINDING1>, <BINDING2>;)

// Tap: space | Shift + tap: dot -> space -> sticky shift | Hold: nav layer.
ZMK_HOLD_TAP(lt_spc,
             bindings = <&mo>, <&spc_morph>;
             flavor = "balanced";
             tapping-term-ms = <200>;
             quick-tap-ms = <QUICK_TAP_MS>;)
SIMPLE_MORPH(spc_morph, SFT, &kp SPACE, &dot_spc)
ZMK_MACRO(dot_spc,
          bindings = <&kp DOT &kp SPACE &sk LSHFT>;
          wait-ms = <0>;
          tap-ms = <5>;)

// Tap: backspace | Shift + tap: dot -> space -> sticky shift | Hold: nav layer.
ZMK_HOLD_TAP(lt_bspc,
             bindings = <&mo>, <&bspc_morph>;
             flavor = "balanced";
             tapping-term-ms = <200>;
             quick-tap-ms = <QUICK_TAP_MS>;)
SIMPLE_MORPH(bspc_morph, SFT, &kp BSPC, &kp DEL)

// Tap: ',' | Shift + tap: ';' | Ctrl + shift + tap: '<'.
SIMPLE_MORPH(comma_morph,       SFT, &kp COMMA,     &comma_inner_morph)
SIMPLE_MORPH(comma_inner_morph, CTL, &kp SEMICOLON, &kp LESS_THAN)

// Tap: '.' | Shift + tap: ':' | Ctrl + shift + tap: '>'.
SIMPLE_MORPH(dot_morph,       SFT, &kp DOT,   &dot_inner_morph)
SIMPLE_MORPH(dot_inner_morph, CTL, &kp COLON, &kp GREATER_THAN)

// Tap: '/' | Shift + tap: '?' | Ctrl + Shift + Tap: '!'.
SIMPLE_MORPH(fslh_morph,       SFT, &kp FSLH,  &fslh_morph_inner)
SIMPLE_MORPH(fslh_morph_inner, CTL, &kp QMARK, &kp EXCL)

// Tap: '(' | Shift + tap: '[' | Ctrl + Shift + Tap: '{'
SIMPLE_MORPH(lpar_morph,       SFT, &kp LPAR, &lpar_morph_inner)
SIMPLE_MORPH(lpar_morph_inner, CTL, &kp LBKT, &kp LBRC)
// Tap: ')' | Shift + tap: ']' | Ctrl + Shift + Tap: '}'
SIMPLE_MORPH(rpar_morph,       SFT, &kp RPAR, &rpar_morph_inner)
SIMPLE_MORPH(rpar_morph_inner, CTL, &kp RBKT, &kp RBRC)

/* ======================================== Magic Shift ========================================= */

// Tap: repeat after alpha, else sticky-shift |
// Shift + tap/ double-tap: caps-word | Hold: shift.
#define MAGIC_SHIFT &magic_shift LSHFT 0
ZMK_HOLD_TAP(
  magic_shift,
  //         hold   tap
  bindings = <&kp>, <&magic_shift_tap>;
  flavor = "balanced";
  tapping-term-ms = <200>;
  quick-tap-ms = <QUICK_TAP_MS>;
)
ZMK_MOD_MORPH(
  magic_shift_tap,
  //         tap          shift tap / ? double-tap ?
  bindings = <&sk LSHFT>, <&caps_word>;
  mods = <(MOD_LSFT)>;
)

&caps_word {
  // Mods deactivate caps-word, requires PR #1451. [TODO: rebase]
  /delete-property/ ignore-modifiers;
};

/* =================================== Custom Rotary Encoders =================================== */

/ {
    behaviors {
        rgb_hue_encoder: rgb_hue_encoder {
            compatible = "zmk,behavior-sensor-rotate";
            #sensor-binding-cells = <0>;
            bindings = <&rgb_ug RGB_HUD>, <&rgb_ug RGB_HUI>;
        };
    };
};

/* =========================================== Layers =========================================== */

#define ZMK_SOFLE_LAYER(name, sensors, LN, RN, LT, RT, LM, RM, LB, RB, LH, RH, LEC, JS0, JS1, JS2, JS3, JS4) \
    ZMK_LAYER(name, LN JS0 RN LT JS4 RT LM JS1 RM LB JS3 RB LEC LH JS2 RH, sensors)

//  ╭─────┬──────────────┬──────────────┬──────────────┬──────────────┬─────────────────────╮                       |                        ╭──────────────┬──────────────┬──────────────┬─────────────┬─────────────────┬─────────╮
//    LN5   LN4            LN3            LN2            LN1            LN0                                         ,                          RN0            RN1            RN2            RN3           RN4               RN5     ,
//  ├─────┼──────────────┼──────────────┼──────────────┼──────────────┼─────────────────────┤                       |                        ├──────────────┼──────────────┼──────────────┼─────────────┼─────────────────┼─────────┤
//    LT5   LT4            LT3            LT2            LT1            LT0                                         ,                          RT0            RT1            RT2            RT3           RT4               RT5     ,
//  ├─────┼──────────────┼──────────────┼──────────────┼──────────────┼─────────────────────┤                       |                        ├──────────────┼──────────────┼──────────────┼─────────────┼─────────────────┼─────────┤
//    LM5   LM4            LM3            LM2            LM1            LM0                                         ,                          RM0            RM1            RM2            RM3           RM4               RM5     ,
//  ├─────┼──────────────┼──────────────┼──────────────┼──────────────┼─────────────────────┤                       |                        ├──────────────┼──────────────┼──────────────┼─────────────┼─────────────────┼─────────┤
//    LB5   LB4            LB3            LB2            LB1            LB0                                         ,                          RB0            RB1            RB2            RB3           RB4               RB5     ,
//  ╰─────┴──────────────┼──────────────┼──────────────┼──────────────┼─────────────────────┼─────────────────────╮ | ╭──────────────────────┼──────────────┼──────────────┼──────────────┼─────────────┼─────────────────┴─────────╯
//                         LH4            LH3            LH2            LH1                   LH0                 ,     RH0                    RH1            RH2            RH3            RH4         ,
//                       ╰──────────────┴──────────────┴──────────────┴─────────────────────┴─────────────────────╯ | ╰──────────────────────┴──────────────┴──────────────┴──────────────┴─────────────╯
//                                                                                                   ╭────────────╮ |                  ╭────────────────╮
//                                                                                                     LEC          ,                    JS0            ,
//                                                                                                   ╰────────────╯ | ╭────────────────┼────────────────┼─────────────────╮
//                                                                                                                      JS1            , JS2            , JS3             ,
//                                                                                                                  | ╰────────────────┼────────────────┼─────────────────╯
//                                                                                                                                     JS4
//                                                                                                                  |                  ╰────────────────╯
                                                                                                                 /* | */
ZMK_SOFLE_LAYER(                                                                                                 /* | */
    Base,                                                                                                        /* | */
    &inc_dec_kp C_VOLUME_UP C_VOL_DN,                                                                            /* | */
//  ╭─────┬──────────────┬──────────────┬──────────────┬──────────────┬─────────────────────╮                       |                        ╭──────────────┬──────────────┬──────────────┬─────────────┬─────────────────┬─────────╮
      XXX   &kp N1         &kp N2         &kp N3         &kp N4         &kp N5                                      ,                          &kp N6         &kp N7         &kp N8         &kp N9        &kp N0            XXX     ,
//  ├─────┼──────────────┼──────────────┼──────────────┼──────────────┼─────────────────────┤                       |                        ├──────────────┼──────────────┼──────────────┼─────────────┼─────────────────┼─────────┤
      XXX   &kp Q          &kp W          &kp E          &kp R          &kp T                                       ,                          &kp Y          &kp U          &kp I          &kp O         &kp P             XXX     ,
//  ├─────┼──────────────┼──────────────┼──────────────┼──────────────┼─────────────────────┤                       |                        ├──────────────┼──────────────┼──────────────┼─────────────┼─────────────────┼─────────┤
      XXX   &hml LGUI A    &hml LALT S    &hml LSHFT D   &hml LCTRL F   &kp G                                       ,                          &kp H          &hmr LCTRL J   &hmr RSHFT K   &hmr LALT L   &hmr LGUI SEMI    &kp SQT ,
//  ├─────┼──────────────┼──────────────┼──────────────┼──────────────┼─────────────────────┤                       |                        ├──────────────┼──────────────┼──────────────┼─────────────┼─────────────────┼─────────┤
      XXX   &kp Z          &kp X          &kp C          &kp V          &kp B                                       ,                          &kp N          &kp M          &comma_morph   &dot_morph    &fslh_morph       XXX     ,
//  ╰─────┴──────────────┼──────────────┼──────────────┼──────────────┼─────────────────────┼─────────────────────╮ | ╭──────────────────────┼──────────────┼──────────────┼──────────────┼─────────────┼─────────────────┴─────────╯
                           XXX            XXX            XXX            &lt LAYER_SYS RET     &lt_spc LAYER_NAV 0   ,   &lt_bspc LAYER_FN 0    MAGIC_SHIFT    &lpar_morph    &rpar_morph    XXX         ,
//                       ╰──────────────┴──────────────┴──────────────┴─────────────────────┴─────────────────────╯ | ╰──────────────────────┴──────────────┴──────────────┴──────────────┴─────────────╯
//                                                                                                   ╭────────────╮ |                  ╭────────────────╮
                                                                                                       &kp C_MUTE   ,                    &kp UP_ARROW   ,
//                                                                                                   ╰────────────╯ | ╭────────────────┼────────────────┼─────────────────╮
                                                                                                                        &kp LEFT_ARROW , &kp ENTER      , &kp RIGHT_ARROW ,
//                                                                                                                  | ╰────────────────┼────────────────┼─────────────────╯
                                                                                                                                         &kp DOWN_ARROW
//                                                                                                                  |                  ╰────────────────╯
)                                                                                                                /* | */
                                                                                                                 /* | */
ZMK_SOFLE_LAYER(                                                                                                 /* | */
    Nav,                                                                                                         /* | */
    &scroll_encoder,                                                                                             /* | */
//  ╭─────┬──────────────┬──────────────┬──────────────┬──────────────┬─────────────────────╮                       |                        ╭──────────────┬──────────────┬──────────────┬─────────────┬─────────────────┬─────────╮
      XXX   XXX            XXX            XXX            XXX            XXX                                         ,                          XXX            XXX            XXX            XXX           XXX               XXX     ,
//  ├─────┼──────────────┼──────────────┼──────────────┼──────────────┼─────────────────────┤                       |                        ├──────────────┼──────────────┼──────────────┼─────────────┼─────────────────┼─────────┤
      XXX   XXX            &ctrl_tab      &alt_tab       XXX            XXX                                         ,                          XXX            XXX            XXX            XXX           XXX               XXX     ,
//  ├─────┼──────────────┼──────────────┼──────────────┼──────────────┼─────────────────────┤                       |                        ├──────────────┼──────────────┼──────────────┼─────────────┼─────────────────┼─────────┤
      XXX   &kp LGUI       &kp LALT       &kp LSHFT      &kp LCTRL      XXX                                         ,                          &kp LEFT       &kp DOWN       &kp UP         &kp RIGHT     XXX               XXX     ,
//  ├─────┼──────────────┼──────────────┼──────────────┼──────────────┼─────────────────────┤                       |                        ├──────────────┼──────────────┼──────────────┼─────────────┼─────────────────┼─────────┤
      XXX   XXX            XXX            XXX            XXX            XXX                                         ,                          &kp HOME       &kp PG_DN      &kp PG_UP      &kp END       XXX               XXX     ,
//  ╰─────┴──────────────┼──────────────┼──────────────┼──────────────┼─────────────────────┼─────────────────────╮ | ╭──────────────────────┼──────────────┼──────────────┼──────────────┼─────────────┼─────────────────┴─────────╯
                           XXX            XXX            XXX            XXX                   XXX                   ,   XXX                    XXX            XXX            XXX            XXX         ,
//                       ╰──────────────┴──────────────┴──────────────┴─────────────────────┴─────────────────────╯ | ╰──────────────────────┴──────────────┴──────────────┴──────────────┴─────────────╯
//                                                                                                   ╭────────────╮ |                  ╭────────────────╮
                                                                                                       ___          ,                    ___            ,
//                                                                                                   ╰────────────╯ | ╭────────────────┼────────────────┼─────────────────╮
                                                                                                                        ___            , ___            , ___             ,
//                                                                                                                  | ╰────────────────┼────────────────┼─────────────────╯
                                                                                                                 /* | */                 ___
//                                                                                                                  |                  ╰────────────────╯
)                                                                                                                /* | */
                                                                                                                 /* | */
#define DESK_PREV &kp LG(LC(LEFT))                                                                               /* | */
#define DESK_NEXT &kp LG(LC(RIGHT))                                                                              /* | */
                                                                                                                 /* | */
ZMK_SOFLE_LAYER(                                                                                                 /* | */
    Fn,                                                                                                          /* | */
    &inc_dec_kp C_VOLUME_UP C_VOL_DN,                                                                            /* | */
//  ╭─────┬──────────────┬──────────────┬──────────────┬──────────────┬─────────────────────╮                       |                        ╭──────────────┬──────────────┬──────────────┬─────────────┬─────────────────┬─────────╮
      XXX   XXX            XXX            XXX            XXX            XXX                                         ,                          XXX            XXX            XXX            XXX           XXX               XXX     ,
//  ├─────┼──────────────┼──────────────┼──────────────┼──────────────┼─────────────────────┤                       |                        ├──────────────┼──────────────┼──────────────┼─────────────┼─────────────────┼─────────┤
      XXX   XXX            &kp LS(F11)    &kp F10        &kp F11        &kp F12                                     ,                          XXX            &kp C_PREV     &kp C_PP       &kp C_NEXT    XXX               XXX     ,
//  ├─────┼──────────────┼──────────────┼──────────────┼──────────────┼─────────────────────┤                       |                        ├──────────────┼──────────────┼──────────────┼─────────────┼─────────────────┼─────────┤
      XXX   &kp F2         &kp F4         &kp F5         &kp F6         &kp F9                                      ,                          XXX            DESK_PREV      XXX            DESK_NEXT     XXX               XXX     ,
//  ├─────┼──────────────┼──────────────┼──────────────┼──────────────┼─────────────────────┤                       |                        ├──────────────┼──────────────┼──────────────┼─────────────┼─────────────────┼─────────┤
      XXX   XXX            XXX            XXX            XXX            XXX                                         ,                          XXX            XXX            XXX            XXX           XXX               XXX     ,
//  ╰─────┴──────────────┼──────────────┼──────────────┼──────────────┼─────────────────────┼─────────────────────╮ | ╭──────────────────────┼──────────────┼──────────────┼──────────────┼─────────────┼─────────────────┴─────────╯
                           XXX            XXX            XXX            XXX                   XXX                   ,   XXX                    XXX            XXX            XXX            XXX         ,
//                       ╰──────────────┴──────────────┴──────────────┴─────────────────────┴─────────────────────╯ | ╰──────────────────────┴──────────────┴──────────────┴──────────────┴─────────────╯
//                                                                                                   ╭────────────╮ |                  ╭────────────────╮
                                                                                                       ___          ,                    ___            ,
//                                                                                                   ╰────────────╯ | ╭────────────────┼────────────────┼─────────────────╮
                                                                                                                        ___            , ___            , ___             ,
//                                                                                                                  | ╰────────────────┼────────────────┼─────────────────╯
                                                                                                                                         ___
//                                                                                                                  |                  ╰────────────────╯
)                                                                                                                /* | */
                                                                                                                 /* | */
ZMK_SOFLE_LAYER(                                                                                                 /* | */
    Sys,                                                                                                         /* | */
    &rgb_hue_encoder,                                                                                            /* | */
//  ╭─────┬──────────────┬──────────────┬──────────────┬──────────────┬─────────────────────╮                       |                        ╭──────────────┬──────────────┬──────────────┬─────────────┬─────────────────┬─────────╮
      XXX   &bt BT_SEL 0   &bt BT_SEL 1   &bt BT_SEL 2   &bt BT_SEL 3   &bt BT_SEL 4                                ,                          XXX            XXX            XXX            XXX           XXX               XXX     ,
//  ├─────┼──────────────┼──────────────┼──────────────┼──────────────┼─────────────────────┤                       |                        ├──────────────┼──────────────┼──────────────┼─────────────┼─────────────────┼─────────┤
      XXX   XXX            XXX            XXX            XXX            &bootloader                                 ,                          &bootloader    XXX            XXX            XXX           XXX               XXX     ,
//  ├─────┼──────────────┼──────────────┼──────────────┼──────────────┼─────────────────────┤                       |                        ├──────────────┼──────────────┼──────────────┼─────────────┼─────────────────┼─────────┤
      XXX   XXX            XXX            XXX            XXX            &sys_reset                                  ,                          &sys_reset     XXX            XXX            XXX           &rgb_ug RGB_EFF   XXX     ,
//  ├─────┼──────────────┼──────────────┼──────────────┼──────────────┼─────────────────────┤                       |                        ├──────────────┼──────────────┼──────────────┼─────────────┼─────────────────┼─────────┤
      XXX   &bt BT_CLR     XXX            XXX            XXX            XXX                                         ,                          XXX            XXX            XXX            XXX           &rgb_ug RGB_EFR   XXX     ,
//  ╰─────┴──────────────┼──────────────┼──────────────┼──────────────┼─────────────────────┼─────────────────────╮ | ╭──────────────────────┼──────────────┼──────────────┼──────────────┼─────────────┼─────────────────┴─────────╯
                           XXX            XXX            XXX            &bt BT_CLR_ALL        XXX                   ,   XXX                    XXX            XXX            XXX            XXX         ,
//                       ╰──────────────┴──────────────┴──────────────┴─────────────────────┴─────────────────────╯ | ╰──────────────────────┴──────────────┴──────────────┴──────────────┴─────────────╯
//                                                                                                   ╭────────────╮ |                   ╭─────────────────╮
                                                                                                       ___          ,                     &rgb_ug RGB_BRI ,
//                                                                                                   ╰────────────╯ | ╭─────────────────┼─────────────────┼─────────────────╮
                                                                                                                        &rgb_ug RGB_HUD , &rgb_ug RGB_TOG , &rgb_ug RGB_HUI ,
//                                                                                                                  | ╰─────────────────┼─────────────────┼─────────────────╯
                                                                                                                                          &rgb_ug RGB_BRD
//                                                                                                                  |                   ╰─────────────────╯
)
